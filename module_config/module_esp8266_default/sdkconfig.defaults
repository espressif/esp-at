## module_config/module_wrover-32/sdkconfig.defaults
```kconfig
# The Optimized Configuration
# Do NOT edit unless you know exactly what you are doing

CONFIG_IDF_TARGET_ESP32=y

# Serial flasher config
CONFIG_ESPTOOLPY_FLASHMODE_DIO=y
CONFIG_ESPTOOLPY_FLASHFREQ_40M=y
CONFIG_ESPTOOLPY_FLASHSIZE_4MB=y

# Bootloader config
CONFIG_BOOTLOADER_WDT_ENABLE=y

# Partition Table
CONFIG_PARTITION_TABLE_CUSTOM=y
CONFIG_PARTITION_TABLE_CUSTOM_FILENAME="module_config/module_wrover-32/partitions_at.csv"
CONFIG_PARTITION_TABLE_CUSTOM_APP_BIN_OFFSET=0x100000
CONFIG_PARTITION_TABLE_CUSTOM_PHY_DATA_OFFSET=0xf000
CONFIG_PARTITION_TABLE_FILENAME="module_config/module_wrover-32/partitions_at.csv"
CONFIG_APP_OFFSET=0x100000
CONFIG_PHY_DATA_OFFSET=0xf000
CONFIG_PARTITION_TABLE_MD5=n

# PHY
CONFIG_ESP32_PHY_INIT_DATA_IN_PARTITION=y
CONFIG_ESP32_SUPPORT_MULTIPLE_PHY_INIT_DATA_BIN=y
CONFIG_ESP32_MULTIPLE_PHY_DATA_BIN_EMBEDDED=y
CONFIG_ESP32_PHY_INIT_DATA_ERROR=y

# ESP32-specific
CONFIG_ESP32_DEFAULT_CPU_FREQ_80=y
CONFIG_ESP32_DEFAULT_CPU_FREQ_MHZ=80
CONFIG_ESP32_XTAL_FREQ_40=y
CONFIG_ESP32_XTAL_FREQ=40
CONFIG_ESP32_SPIRAM_SUPPORT=y
CONFIG_ESP32_RTC_CLK_SRC_EXT_CRYS=y
CONFIG_ESP32_RTC_EXT_CRYST_ADDIT_CURRENT=y
CONFIG_ESP32_RTC_CLK_CAL_CYCLES=1024
CONFIG_ESP32_RTC_XTAL_CAL_RETRY=1
CONFIG_ESP_SYSTEM_RTC_EXT_XTAL_BOOTSTRAP_CYCLES=5

# Power Save
CONFIG_PM_ENABLE=y
CONFIG_PM_USE_RTC_TIMER_REF=y
### Disable all GPIO at light sleep
CONFIG_GPIO_ESP32_SUPPORT_SWITCH_SLP_PULL=y
CONFIG_PM_SLP_DISABLE_GPIO=y

# Wi-Fi
CONFIG_ESP32_WIFI_SW_COEXIST_ENABLE=y
CONFIG_ESP32_WIFI_SW_COEXIST_PREFERENCE_BALANCE=y
CONFIG_ESP32_WIFI_IRAM_OPT=n
CONFIG_ESP_WIFI_SLP_IRAM_OPT=y
CONFIG_ESP_WIFI_STA_DISCONNECTED_PM_ENABLE=y

# Ethernet
CONFIG_DMA_RX_BUF_NUM=3
CONFIG_DMA_TX_BUF_NUM=3

# Component config
CONFIG_BTDM_CTRL_MODE_BTDM=y
CONFIG_BT_ENABLED=y
CONFIG_BT_BLUEDROID_ENABLED=y
CONFIG_BT_DRAM_RELEASE=y
CONFIG_BT_SMP_ENABLE=y
CONFIG_BT_STACK_NO_LOG=y
CONFIG_BT_BLE_DYNAMIC_ENV_MEMORY=y
CONFIG_BTDM_SCAN_DUPL_CACHE_SIZE=200
CONFIG_BT_BTU_TASK_STACK_SIZE=5120
CONFIG_BT_BLE_42_FEATURES_SUPPORTED=y
CONFIG_BT_BLE_BLUFI_ENABLE=y

# Log output
CONFIG_LOG_DEFAULT_LEVEL_ERROR=y
CONFIG_LOG_DEFAULT_LEVEL=1

# Compiler
CONFIG_COMPILER_OPTIMIZATION_DEFAULT=y

# FreeRTOS
CONFIG_FREERTOS_UNICORE=y
CONFIG_FREERTOS_HZ=1000
CONFIG_FREERTOS_USE_TICKLESS_IDLE=y
CONFIG_FREERTOS_CHECK_MUTEX_GIVEN_BY_OWNER=n

# LWIP
CONFIG_LWIP_SO_REUSE=y
CONFIG_LWIP_SO_RCVBUF=y
CONFIG_LWIP_DHCP_MAX_NTP_SERVERS=3
CONFIG_LWIP_SNTP_MAX_SERVERS=3
CONFIG_LWIP_IP_FRAG=y
CONFIG_LWIP_IP_REASSEMBLY=y
CONFIG_LWIP_TCP_MAXRTX=6
CONFIG_LWIP_TCP_SYNMAXRTX=3
CONFIG_LWIP_SO_LINGER=y
CONFIG_LWIP_IPV6=y
CONFIG_LWIP_IPV6_AUTOCONFIG=y
CONFIG_LWIP_TCP_MSS=1440
CONFIG_LWIP_TCP_SND_BUF_DEFAULT=5760
CONFIG_LWIP_TCP_WND_DEFAULT=5760

# mbedTLS
CONFIG_MBEDTLS_HAVE_TIME_DATE=y
CONFIG_MBEDTLS_EXTERNAL_MEM_ALLOC=y

# ESP-TLS
CONFIG_ESP_TLS_SERVER=y
CONFIG_ESP_TLS_PSK_VERIFICATION=y
CONFIG_ESP_TLS_INSECURE=y
CONFIG_ESP_TLS_SKIP_SERVER_CERT_VERIFY=y

# AT Customized Partitions
CONFIG_AT_CUSTOMIZED_PARTITION_TABLE_FILE="module_config/module_wrover-32/at_customize.csv"
CONFIG_AT_CUSTOMIZED_PARTITION_TABLE_OFFSET=0x20000

# AT
CONFIG_AT_ENABLE=y
CONFIG_AT_BASE_ON_UART=y
CONFIG_AT_MQTT_COMMAND_SUPPORT=y
CONFIG_AT_HTTP_COMMAND_SUPPORT=y
CONFIG_AT_BT_COMMAND_SUPPORT=y
CONFIG_AT_BT_SPP_COMMAND_SUPPORT=y
CONFIG_AT_PROCESS_TASK_STACK_SIZE=6144
CONFIG_AT_OTA_SERVER_IP="iot.espressif.cn"
CONFIG_AT_OTA_SERVER_PORT=80
CONFIG_AT_OTA_TOKEN_KEY="dd93253c287f725de50d4071a05dd28b72056ca7"
CONFIG_AT_OTA_SSL_TOKEN_KEY="dd93253c287f725de50d4071a05dd28b72056ca7"
CONFIG_AT_SOCKET_MAX_CONN_NUM=5
CONFIG_ESP_AT_FW_VERSION="2.5.0"

# Wear Levelling
CONFIG_WL_SECTOR_SIZE_512=y

# VFS
CONFIG_FATFS_LFN_HEAP=y
CONFIG_VFS_SUPPORT_TERMIOS=n

# Newlib
CONFIG_NEWLIB_NANO_FORMAT=y

# Common ESP-related
CONFIG_ESP_TASK_WDT_TIMEOUT_S=60
CONFIG_ESP_TASK_WDT_PANIC=y
CONFIG_ESP_ERR_TO_NAME_LOOKUP=n

# Cache config
CONFIG_ESP_DEBUG_STUBS_ENABLE=n
CONFIG_ESP32_DEBUG_OCDAWARE=n

# SPI Flash driver
CONFIG_SPI_FLASH_USE_LEGACY_IMPL=y

# HTTP Server
CONFIG_HTTPD_MAX_REQ_HDR_LEN=1024
CONFIG_HTTPD_MAX_URI_LEN=1024

# ESP HTTPS OTA
CONFIG_OTA_ALLOW_HTTP=y

# MODEM SLEEP Options
CONFIG_BTDM_LPCLK_SEL_EXT_32K_XTAL=y
CONFIG_BTDM_CTRL_LPCLK_SEL_EXT_32K_XTAL=y
CONFIG_ESP32_TIME_SYSCALL_USE_RTC_FRC1=y
```
