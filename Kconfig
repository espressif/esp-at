## module_config/module_esp32c5_default/sdkconfig.defaults
```kconfig
# The Optimized Configuration
# Do NOT edit unless you know exactly what you are doing

CONFIG_IDF_TARGET_ESP32C5=y

# Serial flasher config
CONFIG_ESPTOOLPY_FLASHMODE_DIO=y
CONFIG_ESPTOOLPY_FLASHFREQ_80M=y
CONFIG_ESPTOOLPY_FLASHSIZE_4MB=y

# Bootloader config
CONFIG_BOOTLOADER_WDT_ENABLE=y
CONFIG_BOOTLOADER_APP_ROLLBACK_ENABLE=n
CONFIG_BOOTLOADER_APP_ANTI_ROLLBACK=n
CONFIG_BOOTLOADER_COMPRESSED_ENABLED=y

# Partition Table
CONFIG_PARTITION_TABLE_CUSTOM=y
CONFIG_PARTITION_TABLE_CUSTOM_FILENAME="module_config/module_esp32c5_default/partitions_at.csv"
CONFIG_PARTITION_TABLE_OFFSET=0xc000
CONFIG_PARTITION_TABLE_FILENAME="module_config/module_esp32c5_default/partitions_at.csv"
CONFIG_PARTITION_TABLE_MD5=n

# PHY
CONFIG_ESP_PHY_INIT_DATA_IN_PARTITION=n

# Hardware Settings
CONFIG_ESP_DEFAULT_CPU_FREQ_MHZ_80=y
CONFIG_ESP_DEFAULT_CPU_FREQ_MHZ=80

# Power Save
CONFIG_PM_ENABLE=y
CONFIG_PM_DFS_INIT_AUTO=y
CONFIG_PM_POWER_DOWN_CPU_IN_LIGHT_SLEEP=y
CONFIG_PM_POWER_DOWN_PERIPHERAL_IN_LIGHT_SLEEP=n
### Disable all GPIO at light sleep
CONFIG_PM_SLP_DISABLE_GPIO=y

# Sleep Config
CONFIG_ESP_SLEEP_CACHE_SAFE_ASSERTION=n
CONFIG_ESP_SLEEP_FLASH_LEAKAGE_WORKAROUND=y

# Wi-Fi
CONFIG_ESP_COEX_SW_COEXIST_ENABLE=y
CONFIG_ESP_WIFI_SLP_IRAM_OPT=y
CONFIG_ESP_WIFI_STA_DISCONNECTED_PM_ENABLE=y
CONFIG_ESP_WIFI_ESPNOW_MAX_ENCRYPT_NUM=0
CONFIG_ESP_WIFI_SLP_BEACON_LOST_OPT=y

# Log output
CONFIG_LOG_DEFAULT_LEVEL_ERROR=y

# Compiler
CONFIG_COMPILER_OPTIMIZATION_DEBUG=y

# Bluetooth
CONFIG_BT_ENABLED=y

# NimBLE Options
CONFIG_BT_NIMBLE_ENABLED=y
CONFIG_BT_NIMBLE_BLUFI_ENABLE=y
CONFIG_BT_NIMBLE_50_FEATURE_SUPPORT=y
CONFIG_BT_NIMBLE_EXT_ADV=y
CONFIG_BT_NIMBLE_MAX_CONNECTIONS=4
CONFIG_BT_NIMBLE_MAX_BONDS=10
CONFIG_BT_NIMBLE_WHITELIST_SIZE=10
CONFIG_BT_LE_LL_RESOLV_LIST_SIZE=5
CONFIG_BT_LE_LL_DUP_SCAN_LIST_COUNT=5
CONFIG_BT_NIMBLE_GAP_DEVICE_NAME_MAX_LEN=32
CONFIG_BT_NIMBLE_ATT_PREFERRED_MTU=203
CONFIG_BT_NIMBLE_SECURITY_ENABLE=y
CONFIG_BT_NIMBLE_SM_LEGACY=y
CONFIG_BT_NIMBLE_SM_SC=y
CONFIG_BT_NIMBLE_NVS_PERSIST=y

# FreeRTOS
CONFIG_FREERTOS_UNICORE=y
CONFIG_FREERTOS_HZ=1000
CONFIG_FREERTOS_USE_TICKLESS_IDLE=y
CONFIG_FREERTOS_CHECK_MUTEX_GIVEN_BY_OWNER=n
CONFIG_FREERTOS_PLACE_FUNCTIONS_INTO_FLASH=y
CONFIG_FREERTOS_PLACE_SNAPSHOT_FUNS_INTO_FLASH=y

# LWIP
CONFIG_LWIP_SO_REUSE=y
CONFIG_LWIP_SO_RCVBUF=y
CONFIG_LWIP_DHCP_MAX_NTP_SERVERS=3
CONFIG_LWIP_SNTP_MAX_SERVERS=3
CONFIG_LWIP_IP4_REASSEMBLY=y
CONFIG_LWIP_IP6_REASSEMBLY=y
CONFIG_LWIP_TCP_MAXRTX=6
CONFIG_LWIP_TCP_SYNMAXRTX=3
CONFIG_LWIP_SO_LINGER=y
CONFIG_LWIP_IPV6=y
CONFIG_LWIP_IPV6_AUTOCONFIG=y
CONFIG_LWIP_TCP_MSS=1440
CONFIG_LWIP_TCP_SND_BUF_DEFAULT=5760
CONFIG_LWIP_TCP_WND_DEFAULT=5760
CONFIG_LWIP_SNTP_STARTUP_DELAY=n
CONFIG_LWIP_MAX_SOCKETS=16

# mbedTLS
CONFIG_MBEDTLS_HAVE_TIME_DATE=y
CONFIG_MBEDTLS_HARDWARE_MPI=y
CONFIG_MBEDTLS_DHM_C=y
CONFIG_MBEDTLS_DYNAMIC_BUFFER=y
CONFIG_MBEDTLS_DYNAMIC_FREE_CONFIG_DATA=y
CONFIG_MBEDTLS_DYNAMIC_FREE_CA_CERT=y
CONFIG_MBEDTLS_SSL_KEEP_PEER_CERTIFICATE=n

# ESP-TLS
CONFIG_ESP_TLS_PSK_VERIFICATION=y
CONFIG_ESP_TLS_INSECURE=y
CONFIG_ESP_TLS_SKIP_SERVER_CERT_VERIFY=y

# MQTT
CONFIG_MQTT_REPORT_DELETED_MESSAGES=y
CONFIG_MQTT_MSG_ID_INCREMENTAL=y

# Hardware Settings
CONFIG_RTC_CLK_SRC_EXT_CRYS=y
CONFIG_RTC_CLK_CAL_CYCLES=1024

# AT Customized Partitions
CONFIG_AT_CUSTOMIZED_PARTITION_TABLE_FILE="module_config/module_esp32c5_default/at_customize.csv"
CONFIG_AT_CUSTOMIZED_PARTITION_TABLE_OFFSET=0x30000

# AT
CONFIG_AT_ENABLE=y
CONFIG_AT_BASE_ON_UART=y
CONFIG_AT_MQTT_COMMAND_SUPPORT=y
CONFIG_AT_HTTP_COMMAND_SUPPORT=y
CONFIG_AT_PROCESS_TASK_STACK_SIZE=6144
CONFIG_AT_OTA_SERVER_IP="iot.espressif.cn"
CONFIG_AT_OTA_SERVER_PORT=80
CONFIG_AT_OTA_TOKEN_KEY="dd93253c287f725de50d4071a05dd28b72056ca7"
CONFIG_AT_OTA_SSL_TOKEN_KEY="dd93253c287f725de50d4071a05dd28b72056ca7"
CONFIG_AT_SOCKET_MAX_CONN_NUM=5
CONFIG_AT_BLE_HID_COMMAND_SUPPORT=n
CONFIG_AT_BLUFI_COMMAND_SUPPORT=y
CONFIG_AT_SIGNALING_COMMAND_SUPPORT=n

# Application manager
CONFIG_APP_PROJECT_VER_FROM_CONFIG=y
CONFIG_APP_PROJECT_VER="v4.2.0.0-dev"

# Wear Levelling
CONFIG_WL_SECTOR_SIZE_512=y

# VFS
CONFIG_FATFS_LFN_HEAP=y
CONFIG_VFS_SUPPORT_TERMIOS=n

# Newlib
CONFIG_LIBC_NEWLIB_NANO_FORMAT=y

# Common ESP-related
CONFIG_ESP_TASK_WDT_TIMEOUT_S=60
CONFIG_ESP_TASK_WDT_PANIC=y
CONFIG_ESP_ERR_TO_NAME_LOOKUP=n

# Cache config
CONFIG_ESP_DEBUG_STUBS_ENABLE=n
CONFIG_ESP_DEBUG_OCDAWARE=n

# HTTP Server
CONFIG_HTTPD_MAX_REQ_HDR_LEN=1024
CONFIG_HTTPD_MAX_URI_LEN=1024

# ESP System Settings
CONFIG_ESP_SYSTEM_RTC_EXT_XTAL=y
CONFIG_ESP_SYSTEM_RTC_EXT_XTAL_BOOTSTRAP_CYCLES=0
CONFIG_ESP_CONSOLE_USB_SERIAL_JTAG=n
CONFIG_ESP_CONSOLE_SECONDARY_USB_SERIAL_JTAG=n

# ESP HTTPS OTA
CONFIG_ESP_HTTPS_OTA_ALLOW_HTTP=y

# Bluetooth Low Power Config
CONFIG_BT_LE_SLEEP_ENABLE=y
CONFIG_BT_LE_LP_CLK_SRC_DEFAULT=y
```

## module_config/module_esp32s2_default/sdkconfig.defaults
```kconfig
# The Optimized Configuration
# Do NOT edit unless you know exactly what you are doing

CONFIG_IDF_TARGET_ESP32S2=y

# Serial flasher config
CONFIG_ESPTOOLPY_FLASHMODE_DIO=y
CONFIG_ESPTOOLPY_FLASHFREQ_80M=y
CONFIG_ESPTOOLPY_FLASHSIZE_4MB=y

# Bootloader config
CONFIG_BOOTLOADER_WDT_ENABLE=y

# Partition Table
CONFIG_PARTITION_TABLE_CUSTOM=y
CONFIG_PARTITION_TABLE_CUSTOM_FILENAME="module_config/module_esp32s2_default/partitions_at.csv"
CONFIG_PARTITION_TABLE_OFFSET=0x8000
CONFIG_PARTITION_TABLE_FILENAME="module_config/module_esp32s2_default/partitions_at.csv"
CONFIG_PARTITION_TABLE_MD5=n

# PHY
CONFIG_ESP_PHY_INIT_DATA_IN_PARTITION=n

# Hardware Settings
CONFIG_ESP_DEFAULT_CPU_FREQ_MHZ_160=y
CONFIG_ESP_DEFAULT_CPU_FREQ_MHZ=160
CONFIG_XTAL_FREQ_40=y
CONFIG_XTAL_FREQ=40

# Power Save
CONFIG_PM_ENABLE=y
CONFIG_PM_USE_RTC_TIMER_REF=y
### Disable all GPIO at light sleep
CONFIG_PM_SLP_DISABLE_GPIO=y

# ESP Ringbuf
CONFIG_RINGBUF_PLACE_FUNCTIONS_INTO_FLASH=y
CONFIG_RINGBUF_PLACE_ISR_FUNCTIONS_INTO_FLASH=y
# Wi-Fi
CONFIG_ESP_WIFI_SLP_IRAM_OPT=y
CONFIG_ESP_WIFI_STA_DISCONNECTED_PM_ENABLE=y
CONFIG_ESP32_WIFI_IRAM_OPT=n
CONFIG_ESP32_WIFI_RX_IRAM_OPT=n
CONFIG_ESP_WIFI_ESPNOW_MAX_ENCRYPT_NUM=0

# Log output
CONFIG_LOG_DEFAULT_LEVEL_ERROR=y

# Compiler
CONFIG_COMPILER_OPTIMIZATION_DEFAULT=y

# Bluetooth
CONFIG_BT_ENABLED=n

# FreeRTOS
CONFIG_FREERTOS_UNICORE=y
CONFIG_FREERTOS_HZ=1000
CONFIG_FREERTOS_USE_TICKLESS_IDLE=y
CONFIG_FREERTOS_CHECK_MUTEX_GIVEN_BY_OWNER=n
CONFIG_FREERTOS_PLACE_FUNCTIONS_INTO_FLASH=y
CONFIG_FREERTOS_PLACE_SNAPSHOT_FUNS_INTO_FLASH=y

# LWIP
CONFIG_LWIP_SO_REUSE=y
CONFIG_LWIP_SO_RCVBUF=y
CONFIG_LWIP_DHCP_MAX_NTP_SERVERS=3
CONFIG_LWIP_SNTP_MAX_SERVERS=3
CONFIG_LWIP_IP_FRAG=y
CONFIG_LWIP_IP_REASSEMBLY=y
CONFIG_LWIP_TCP_MAXRTX=6
CONFIG_LWIP_TCP_SYNMAXRTX=3
CONFIG_LWIP_SO_LINGER=y
CONFIG_LWIP_IPV6=y
CONFIG_LWIP_IPV6_AUTOCONFIG=y
CONFIG_LWIP_TCP_MSS=1440
CONFIG_LWIP_TCP_SND_BUF_DEFAULT=5760
CONFIG_LWIP_TCP_WND_DEFAULT=5760

# mbedTLS
CONFIG_MBEDTLS_HAVE_TIME_DATE=y
CONFIG_MBEDTLS_HARDWARE_MPI=y
CONFIG_MBEDTLS_DHM_C=y
CONFIG_MBEDTLS_DYNAMIC_BUFFER=y
CONFIG_MBEDTLS_DYNAMIC_FREE_CONFIG_DATA=y
CONFIG_MBEDTLS_DYNAMIC_FREE_CA_CERT=y
CONFIG_MBEDTLS_SSL_KEEP_PEER_CERTIFICATE=n

# ESP-TLS
CONFIG_ESP_TLS_SERVER=y
CONFIG_ESP_TLS_PSK_VERIFICATION=y
CONFIG_ESP_TLS_INSECURE=y
CONFIG_ESP_TLS_SKIP_SERVER_CERT_VERIFY=y

# AT Customized Partitions
CONFIG_AT_CUSTOMIZED_PARTITION_TABLE_FILE="module_config/module_esp32s2_default/at_customize.csv"
CONFIG_AT_CUSTOMIZED_PARTITION_TABLE_OFFSET=0x20000

# AT
CONFIG_AT_ENABLE=y
CONFIG_AT_BASE_ON_UART=y
CONFIG_AT_MQTT_COMMAND_SUPPORT=y
CONFIG_AT_HTTP_COMMAND_SUPPORT=y
CONFIG_AT_BLE_COMMAND_SUPPORT=n
CONFIG_AT_PROCESS_TASK_STACK_SIZE=6144
CONFIG_AT_OTA_SERVER_IP="iot.espressif.cn"
CONFIG_AT_OTA_SERVER_PORT=80
CONFIG_AT_OTA_TOKEN_KEY="dd93253c287f725de50d4071a05dd28b72056ca7"
CONFIG_AT_OTA_SSL_TOKEN_KEY="dd93253c287f725de50d4071a05dd28b72056ca7"
CONFIG_AT_SOCKET_MAX_CONN_NUM=5
CONFIG_ESP_AT_FW_VERSION="v3.4.0.0"

# Wear Levelling
CONFIG_WL_SECTOR_SIZE_512=y

# VFS
CONFIG_FATFS_LFN_HEAP=y
CONFIG_VFS_SUPPORT_TERMIOS=n

# Newlib
CONFIG_NEWLIB_NANO_FORMAT=y

# Common ESP-related
CONFIG_ESP_TASK_WDT_TIMEOUT_S=60
CONFIG_ESP_TASK_WDT_PANIC=y
CONFIG_ESP_ERR_TO_NAME_LOOKUP=n

# Cache config
CONFIG_ESP_DEBUG_STUBS_ENABLE=n
CONFIG_ESP_DEBUG_OCDAWARE=n

# SPI Flash driver
CONFIG_SPI_FLASH_USE_LEGACY_IMPL=y
CONFIG_SPI_FLASH_ENABLE_ENCRYPTED_READ_WRITE=n

# HTTP Server
CONFIG_HTTPD_MAX_REQ_HDR_LEN=1024
CONFIG_HTTPD_MAX_URI_LEN=1024

# ESP HTTPS OTA
CONFIG_ESP_HTTPS_OTA_ALLOW_HTTP=y
```

## module_config/module_esp8266_1mb/sdkconfig.defaults
```kconfig
# The Optimized Configuration
# Do NOT edit unless you know exactly what you are doing

CONFIG_IDF_TARGET_ESP8266=y

# Serial flasher config
CONFIG_ESPTOOLPY_FLASHMODE_DOUT=y
CONFIG_ESPTOOLPY_FLASHMODE="dout"
CONFIG_ESPTOOLPY_FLASHFREQ_80M=y
CONFIG_ESPTOOLPY_FLASHFREQ="80m"
CONFIG_ESPTOOLPY_FLASHSIZE_1MB=y
CONFIG_ESPTOOLPY_MONITOR_BAUD_115200B=y

# Partition Table
CONFIG_PARTITION_TABLE_CUSTOM=y
CONFIG_PARTITION_TABLE_CUSTOM_FILENAME="module_config/module_esp8266_1mb/partitions_at.csv"
CONFIG_PARTITION_TABLE_FILENAME="module_config/module_esp8266_1mb/partitions_at.csv"
CONFIG_COMPILER_OPTIMIZATION_LEVEL_DEBUG=y

# PHY
CONFIG_ESP_PHY_INIT_DATA_IN_PARTITION=n
CONFIG_ESP8266_PHY_MAX_WIFI_TX_POWER=21

# AT Customized Partitions
CONFIG_AT_CUSTOMIZED_PARTITION_TABLE_FILE="module_config/module_esp8266_1mb/at_customize.csv"
CONFIG_AT_CUSTOMIZED_PARTITION_TABLE_OFFSET=0x18000

# ESP8266-specific
CONFIG_ESP8266_DEFAULT_CPU_FREQ_160=y
CONFIG_ESP8266_DEFAULT_CPU_FREQ_MHZ=160

# Common ESP-related
CONFIG_ESP_ERR_TO_NAME_LOOKUP=n
CONFIG_ESP_CONSOLE_UART_CUSTOM=y
CONFIG_ESP_CONSOLE_UART_CUSTOM_NUM_1=y
CONFIG_ESP_CONSOLE_UART_NUM=1
CONFIG_ESP_CONSOLE_UART_BAUDRATE=115200
CONFIG_EVENT_LOOP_STACK_SIZE=1536

# Power Management
CONFIG_PM_ENABLE=y

# FreeRTOS
CONFIG_FREERTOS_HZ=1000
CONFIG_USE_QUEUE_SETS=y
CONFIG_FREERTOS_TIMER_STACKSIZE=1536

# LWIP
CONFIG_LWIP_SO_REUSE=y
CONFIG_LWIP_SO_RCVBUF=y
CONFIG_LWIP_DHCP_MAX_NTP_SERVERS=3
CONFIG_LWIP_IP_FRAG=y
CONFIG_LWIP_IP_REASSEMBLY=y
CONFIG_LWIP_TCP_MAXRTX=6
CONFIG_LWIP_TCP_SYNMAXRTX=3
CONFIG_LWIP_RAW=y
CONFIG_LWIP_NETIF_LOOPBACK=y
CONFIG_ESP_LWIP_RECV_REST_DATA=y
CONFIG_TCP_HIGH_SPEED_RETRANSMISSION=y
CONFIG_LWIP_SO_LINGER=y
CONFIG_LWIP_IPV6=y
CONFIG_LWIP_IPV6_AUTOCONFIG=y
CONFIG_LWIP_TCP_MSS=1440
CONFIG_LWIP_TCP_SND_BUF_DEFAULT=2880
CONFIG_LWIP_TCP_WND_DEFAULT=5760

# mDNS
CONFIG_ENABLE_MDNS=y
CONFIG_MDNS_MAX_SERVICES=5

# wpa_supplicant	
CONFIG_LTM_FAST=n

# mbedTLS
CONFIG_MBEDTLS_SSL_OUT_CONTENT_LEN=4096
CONFIG_MBEDTLS_SSL_IN_CONTENT_LEN=16384
CONFIG_MBEDTLS_RSA_BITLEN_2048=y
CONFIG_MBEDTLS_DYNAMIC_BUFFER=y
CONFIG_MBEDTLS_DYNAMIC_FREE_PEER_CERT=y
CONFIG_MBEDTLS_DYNAMIC_FREE_CONFIG_DATA=y

# ESP-TLS
CONFIG_ESP_TLS_USING_MBEDTLS=y
CONFIG_ESP_TLS_PSK_VERIFICATION=y

# MQTT
CONFIG_MQTT_USE_CUSTOM_CONFIG=y
CONFIG_MQTT_BUFFER_SIZE=512
CONFIG_MQTT_TASK_STACK_SIZE=2048

# AT
CONFIG_AT_ENABLE=y
CONFIG_AT_BASE_ON_UART=y
CONFIG_AT_PROCESS_TASK_STACK_SIZE=1792
CONFIG_AT_SOCKET_TASK_STACK_SIZE=4096
CONFIG_AT_SSL_SERVER_SERVER_AUTH_CLIENT=n
CONFIG_AT_SSL_SERVER_CLIENT_AUTH_SERVER=n
CONFIG_AT_MQTT_COMMAND_SUPPORT=y
CONFIG_AT_OTA_SUPPORT=n
CONFIG_AT_SOCKET_MAX_CONN_NUM=5
CONFIG_ESP_AT_FW_VERSION="2.2.1"

# VFS
CONFIG_SUPPORT_TERMIOS=n

# Newlib
CONFIG_NEWLIB_LIBRARY_LEVEL_FLOAT_NANO=y

# LOG
CONFIG_LOG_DEFAULT_LEVEL_ERROR=y
```
