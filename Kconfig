## Kconfig
```kconfig
menu "wolfSSL"

    config TLS_STACK_WOLFSSL
    bool "Include wolfSSL in esp-tls"
    default y
    help
        Includes wolfSSL in the esp-tls so that , esp-tls can be compiled with wolfSSL as its SSL/TLS library.

endmenu # wolfSSL
```

## components/customized_partitions/Kconfig.projbuild
```kconfig
menu "AT Customized Partitions"

choice
    prompt "AT Customized Partition Table"
    default AT_CUSTOMIZED_PARTITION_TABLE_SUPPORT
    help
        enable AT customized partition table
        refer to README.md in components/customized_partitions

config AT_CUSTOMIZED_PARTITION_TABLE_SUPPORT
    bool "enable AT customized partition table"

config DISABLE_AT_CUSTOMIZED_PARTITIOTN_TABLE
    bool "disable AT customized partition table"
endchoice

config AT_CUSTOMIZED_PARTITION_TABLE_FILE
    string "AT Customized partition file"
    depends on AT_CUSTOMIZED_PARTITION_TABLE_SUPPORT
    default at_customize.csv
    help
        partition table path

config AT_CUSTOMIZED_PARTITION_TABLE_OFFSET
    hex "offset of AT customized partition table"
    depends on AT_CUSTOMIZED_PARTITION_TABLE_SUPPORT
    default 0x20000
    help
        MUST set the same value as customized bin offset defined in AT partition table

endmenu
```

## components/esp-wolfssl/Kconfig
```kconfig
menu "wolfSSL"

    config TLS_STACK_WOLFSSL
        bool "Include wolfSSL in esp-tls"
        default y
        help
            Includes wolfSSL in the esp-tls so that , esp-tls can be compiled with wolfSSL as its SSL/TLS library.

    config WOLFSSL_HAVE_ALPN
        bool "Enable ALPN(Application Layer Protocol Negotiation) in wolfSSL"
        default y
        help
            Enables ALPN option in wolfSSL.

endmenu # wolfSSL
```

## example/at_http_webserver/main/Kconfig
```kconfig
menu "AT"

config AT_ENABLE
    bool "Enable AT"
    default "y"

config AT_COMMAND_TERMINATOR_SUPPORT
    bool "AT command terminator support."
    default "n"
    depends on AT_ENABLE

config AT_COMMAND_TERMINATOR
    hex "AT command terminator. "
    help 
        Now just support one character, the range is from 0x01 to 0xFF.
    range 0x01 0xFF
    default 0x0A
    depends on AT_COMMAND_TERMINATOR_SUPPORT

config AT_BASE_COMMAND_SUPPORT
    bool "AT base command support."
    default "y"
    depends on AT_ENABLE

config AT_WIFI_COMMAND_SUPPORT
    bool "AT wifi command support."
    default "y"
    depends on AT_ENABLE

config AT_NET_COMMAND_SUPPORT
    bool "AT net command support."
    default "y"
    depends on AT_WIFI_COMMAND_SUPPORT
    
config AT_BLE_COMMAND_SUPPORT
    bool "AT ble command support."
    default "y"
    depends on AT_ENABLE
    
config AT_FS_COMMAND_SUPPORT
    bool "AT FS command support."
    default "y"
    depends on AT_ENABLE
    select WL_SECTOR_SIZE_512
    select FATFS_LFN_HEAP
    
endmenu
```

## examples/at_http_webserver/main/Kconfig
```kconfig
menu "AT HTTP SERVER"

choice ESP_INIT_WIFI_MODE
    prompt "Initial WiFi mode"
    default ESP_WIFI_IS_SOFTAP
    help
        Whether the init esp32 is softAP or station.

config ESP_WIFI_IS_SOFTAP
    bool "SoftAP"
config ESP_WIFI_IS_STATION
    bool "Station"
endchoice

config ESP_WIFI_MODE_AP
    bool
    default y if ESP_WIFI_IS_SOFTAP
    default n if ESP_WIFI_IS_STATION

config ESP_WIFI_SSID
    string "WiFi SSID"
    default "AT_HTTP_WEBSERVER"
    help
	SSID (network name) for the example to connect to.

config ESP_WIFI_PASSWORD
    string "WiFi Password"
    default "12345678"
    help
	WiFi password (WPA or WPA2) for the example to use.

choice OPERATE_FILE_SYSTEM
    prompt "read file system"
    default FILE_FUNCTION
    help
        How to read file system

config FILE_FUNCTION
    bool "read file function"
config AT_COMMAND
    bool "File system AT command"
endchoice

config READ_WRITE_FILE_SYSTEM
    bool
    default y if FILE_FUNCTION
    default n if AT_COMMAND

config AT_ENABLE
    bool "Enable AT"
    default "y"

config AT_BASE_COMMAND_SUPPORT
    bool "AT base command support."
    default "y"
    depends on AT_ENABLE

config AT_WIFI_COMMAND_SUPPORT
    bool "AT wifi command support."
    default "y"
    depends on AT_ENABLE

config AT_NET_COMMAND_SUPPORT
    bool "AT net command support."
    default "y"
    depends on AT_WIFI_COMMAND_SUPPORT
    
config AT_BLE_COMMAND_SUPPORT
    bool "AT ble command support."
    default "y"
    depends on AT_ENABLE

config AT_BLE_HID_COMMAND_SUPPORT
    bool "AT ble hid command support."
    default "y"
    depends on AT_ENABLE

config AT_FS_COMMAND_SUPPORT
    bool "AT FS command support."
    default "y"
    depends on AT_ENABLE
    select WL_SECTOR_SIZE_512
    select FATFS_LFN_HEAP

endmenu
```

## examples/at_interface_security/Kconfig
```kconfig
menu "AT Interface Security Configuration"
    config AT_INTF_SECURITY_SUPPORT
        bool "Enable AT Interface Security"
        default y
endmenu
```

## examples/at_override_module_config/sdkconfig.defaults
```kconfig
# Override default configurations

# Override System Partition Table
CONFIG_PARTITION_TABLE_CUSTOM_FILENAME="partitions_at.csv"
CONFIG_PARTITION_TABLE_FILENAME="partitions_at.csv"

# Override User Partition Table
CONFIG_AT_CUSTOMIZED_PARTITION_TABLE_FILE="at_customize.csv"

# Enable WebSocket and disable mDNS
CONFIG_AT_WS_COMMAND_SUPPORT=y
CONFIG_AT_MDNS_COMMAND_SUPPORT=n
```

## examples/at_sdio_host/ESP32/main/Kconfig.projbuild
```kconfig
menu "SDIO HOST Configuration"

choice TARGET_PLATFORM
    prompt "Select slave platform."
    default SLAVE_ESP32
    help
        Select which target is used.

config SLAVE_ESP32
    bool "Using ESP32"
endchoice

endmenu
```

## examples/at_sdio_host/main/Kconfig.projbuild
```kconfig
menu "Example Configuration"

config SDIO_EXAMPLE_4BIT
    bool "Host tries using 4-bit mode to communicate with slave"
    default n
    help
        If this is set, the host tries using 4-bit mode to communicate with
        slave. If failed, the communication falls back to 1-bit mode.
        
        If this is not set, the host uses 1-bit mode. However, DAT1 is still
        mandatory for interrupts.

        Note that 4-bit mode is not compatible (by default) if the slave is
        using 3.3V flash which requires a pull-down on the MTDI pin (Stripping pin).

config SDIO_EXAMPLE_HIGHSPEED
    bool "Host tries using HS mode to communicate with slave"
    default y
    help
        If this is set, the host tries using high-speed (40M) mode to communicate
        with slave. If the slave doesn't support high-speed mode, the
        communication falls back to default-speed (20M) mode. If this is not set,
        the host uses default speed mode.

        If the example does not work, please try disabling the high-speed mode.

endmenu
```

## examples/at_spi_master/spi/esp32_c_series/main/Kconfig.projbuild
```kconfig
menu "SPI master Configuration"

choice SPI_TRANSMIT
    prompt "communicate way for SPI transmit"
    default SPI_SINGLE_MODE

config SPI_SINGLE_MODE
    bool "Standard SPI"
    help
        The MCU can transmit data through MOSI or MISO line.
config SPI_DUAL_MODE
    bool "Dual SPI"
    help
        The MCU can transmit data through MOSI and MISO line.
config SPI_QUAD_MODE
    bool "Quad SPI"
    help
        Quad SPI goes beyond dual SPI, adding two more I/O lines and sends 4 data bits per clock cycle.
endchoice

menu "spi gpio settings"
    config SPI_SCLK_PIN
        int "SPI sclk pin"
        default 15 if IDF_TARGET_ESP32
        default 6 if IDF_TARGET_ESP32C3
    config SPI_MOSI_PIN
        int "SPI mosi pin"
        default 13 if IDF_TARGET_ESP32
        default 7 if IDF_TARGET_ESP32C3
    config SPI_MISO_PIN
        int "SPI miso pin"
        default 12 if IDF_TARGET_ESP32
        default 2 if IDF_TARGET_ESP32C3
    config SPI_CS_PIN
        int "SPI cs pin"
        default 14 if IDF_TARGET_ESP32
        default 10 if IDF_TARGET_ESP32C3
    config SPI_HANDSHAKE_PIN
        int "SPI handshake pin for slave send"
        default 5 if IDF_TARGET_ESP32
        default 3 if IDF_TARGET_ESP32C3
    config SPI_WP_PIN
        int "SPI WP pin(quad spi)"
        default 16 if IDF_TARGET_ESP32
        default 8 if IDF_TARGET_ESP32C3
        depends on SPI_QUAD_MODE
    config SPI_HD_PIN
        int "SPI HD pin(quad spi)"
        default 17 if IDF_TARGET_ESP32
        default 9 if IDF_TARGET_ESP32C3
        depends on SPI_QUAD_MODE
endmenu

endmenu
```

## examples/at_spi_master/spi/esp32_c_series/sdkconfig.defaults
```kconfig
CONFIG_ESP32_DEFAULT_CPU_FREQ_240=y
CONFIG_ESP32_DEFAULT_CPU_FREQ_MHZ=240

CONFIG_FREERTOS_UNICORE=y
CONFIG_FREERTOS_HZ=1000

CONFIG_FLASHMODE_QIO=y
CONFIG_ESPTOOLPY_FLASHFREQ_80M=y
```

## examples/wolfssl_client/main/Kconfig.projbuild
```kconfig
menu "wolfSSL_client_demo"

    config CERT_AUTH
        bool      "Enable_cert_authentication"
        default   y
        help
	          Enabling this flags authenticates the server certificate while establishing a tls connection

endmenu # wolfSSL_client_demo
```
