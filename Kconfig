## main/Kconfig
```kconfig
menu "AT"
config AT_ENABLE
    bool "Enable AT Commands"
    default "y"

choice AT_COMMUNICATION_METHOD
    prompt "communicate method for AT command"
    default AT_BASE_ON_UART
    depends on AT_ENABLE

rsource "interface/uart/Kconfig"
rsource "interface/spi/Kconfig"
rsource "interface/socket/Kconfig"
rsource "interface/sdio/Kconfig"

endchoice

config AT_PROCESS_TASK_STACK_SIZE
    int "The stack size of the AT process task in AT library, which will be used to process AT command"
    default 2048
    depends on AT_ENABLE

config AT_SOCKET_TASK_STACK_SIZE
    int "The stack size of the AT socket task in AT library, which will be used to process socket link"
    default 6144
    range 2048 8196
    depends on AT_ENABLE

config AT_COMMAND_TERMINATOR_SUPPORT
    bool "AT command terminator support."
    default "n"
    depends on AT_ENABLE

config AT_COMMAND_TERMINATOR
    hex "AT command terminator."
    range 0x01 0xFF
    default 0x0A
    depends on AT_COMMAND_TERMINATOR_SUPPORT
    help
        Now just support one character, the range is from 0x01 to 0xFF.

config AT_SELF_COMMAND_SUPPORT
    bool "Support for executing AT commands from esp-at itself instead of external MCU."
    default n
    depends on AT_ENABLE

config AT_BASE_COMMAND_SUPPORT
    bool "AT base command support."
    default "y"
    depends on AT_ENABLE

config AT_USER_COMMAND_SUPPORT
    bool "AT user command support."
    default "y"
    depends on AT_ENABLE

config AT_USERWKMCU_COMMAND_SUPPORT
    bool "AT+USERWKMCU command support."
    default "y"
    depends on AT_USER_COMMAND_SUPPORT

config AT_WIFI_COMMAND_SUPPORT
    bool "AT wifi command support."
    default "y"
    depends on AT_ENABLE

config AT_NET_COMMAND_SUPPORT
    bool "AT net command support."
    default "y"
    depends on AT_ENABLE

config AT_SOCKET_MAX_CONN_NUM
    int "AT socket maximum connection number"
    default 5
    depends on AT_NET_COMMAND_SUPPORT

menu "AT ssl client authentication method"
    depends on AT_NET_COMMAND_SUPPORT

config AT_SSL_CLIENT_SERVER_AUTH_CLIENT
    bool "Server authenticates client, client_cert and client_key partition MUST exist in at_customize.csv"
    default y

config AT_SSL_CLIENT_CLIENT_AUTH_SERVER
    bool "Client authenticates server, client_ca partition MUST exist in at_customize.csv"
    default y
endmenu

menu "AT ssl server authentication method"
    depends on AT_NET_COMMAND_SUPPORT

config AT_SSL_SERVER_SERVER_AUTH_CLIENT
    bool "Server authenticates clients, server_ca partition MUST exist in at_customize.csv"
    default y

config AT_SSL_SERVER_CLIENT_AUTH_SERVER
    bool "Client authenticates server, server_cert and server_key partition MUST exist in at_customize.csv"
    default y
endmenu

config AT_MDNS_COMMAND_SUPPORT
    bool "AT MDNS command support."
    default "y"
    depends on AT_ENABLE

config AT_WPS_COMMAND_SUPPORT
    bool "AT WPS command support."
    default "y"
    depends on AT_WIFI_COMMAND_SUPPORT

config AT_SMARTCONFIG_COMMAND_SUPPORT
    bool "AT smartconfig command support."
    default "y"
    depends on AT_WIFI_COMMAND_SUPPORT

config AT_PING_COMMAND_SUPPORT
    bool "AT ping command support."
    default "y"
    depends on AT_ENABLE

config AT_MQTT_COMMAND_SUPPORT
    bool "AT MQTT command support."
    default "n"
    depends on AT_ENABLE

menu "AT MQTT authentication method"
    depends on AT_MQTT_COMMAND_SUPPORT

config AT_MQTT_BROKER_AUTH_CLIENT
    bool "Broker authenticates clients, mqtt_ca partition MUST exist in at_customize.csv"
    default y

config AT_MQTT_CLIENT_AUTH_BROKER
    bool "Client authenticates Broker, mqtt_cert and mqtt_key partition MUST exist in at_customize.csv"
    default y
endmenu

config AT_HTTP_COMMAND_SUPPORT
    bool "AT HTTP command support."
    default "n"
    depends on AT_ENABLE
    help
        Please enlarge AT_PROCESS_TASK_STACK_SIZE to be more than 4096 if HTTPS link need to establish,
        otherwise, unexpected crash probably occur due to AT process task overflow.

menu "AT HTTP authentication method"
    depends on AT_HTTP_COMMAND_SUPPORT

config AT_HTTPS_SERVER_AUTH_CLIENT
    bool "HTTPS server authenticates clients"
    default n

config AT_HTTPS_CLIENT_AUTH_SERVER
    bool "HTTPS client authenticates server"
    default n
endmenu

config AT_HTTP_TX_BUFFER_SIZE
    int "Default HTTP TX buffer size"
    default 2048
    depends on AT_HTTP_COMMAND_SUPPORT
    help
        This buffer size using for transmit HTTP request

config AT_HTTP_RX_BUFFER_SIZE
    int "Default HTTP RX buffer size"
    default 2048
    depends on AT_HTTP_COMMAND_SUPPORT
    help
        This buffer size using for receive HTTP response

config AT_WS_COMMAND_SUPPORT
    bool "AT WebSocket command support."
    default "n"
    depends on AT_ENABLE

menu "AT WebSocket authentication method"
    depends on AT_WS_COMMAND_SUPPORT

config AT_WSS_SERVER_AUTH_CLIENT
    bool "Server authenticates clients"
    default y

config AT_WSS_CLIENT_AUTH_SERVER
    bool "Client authenticates server"
    default y
endmenu

config AT_BLE_COMMAND_SUPPORT
    bool "AT ble command support."
    default "y" if !IDF_TARGET_ESP32C2
    default "n" if IDF_TARGET_ESP32C2
    depends on AT_ENABLE && BT_ENABLED

config AT_BLE_HID_COMMAND_SUPPORT
    bool "AT ble hid command support."
    default "y"
    depends on AT_ENABLE && BT_ENABLED && !IDF_TARGET_ESP32C2 && !IDF_TARGET_ESP32C6

config AT_BLUFI_COMMAND_SUPPORT
    bool "AT blufi command support."
    default "y"
    depends on AT_ENABLE && BT_ENABLED && (!IDF_TARGET_ESP32C2 || (BT_NIMBLE_ENABLED && BT_NIMBLE_BLUFI_ENABLE && BT_NIMBLE_EXT_ADV))

config AT_BT_COMMAND_SUPPORT
    bool "AT bt command support."
    default "n"
    select BT_CLASSIC_ENABLED
    select BT_ALLOCATION_FROM_SPIRAM_FIRST
    depends on AT_ENABLE && BT_ENABLED && IDF_TARGET_ESP32

config AT_BT_SPP_COMMAND_SUPPORT
    bool "AT bt spp command support."
    default "y"
    select BT_SPP_ENABLED
    depends on AT_BT_COMMAND_SUPPORT

config AT_BT_A2DP_COMMAND_SUPPORT
    bool "AT bt a2dp command support."
    default "n"
    select BT_A2DP_ENABLE
    depends on AT_BT_COMMAND_SUPPORT

config AT_I2S_LRCK_PIN
    int "I2S LRCK (WS) GPIO"
    default 18
    depends on AT_BT_A2DP_COMMAND_SUPPORT
    help
        GPIO number to use for I2S LRCK(WS) Driver.

config AT_I2S_BCK_PIN
    int "I2S BCK GPIO"
    default 26
    depends on AT_BT_A2DP_COMMAND_SUPPORT
    help
        GPIO number to use for I2S BCK Driver.

config AT_I2S_DATA_PIN
    int "I2S DATA GPIO"
    default 25
    depends on AT_BT_A2DP_COMMAND_SUPPORT
    help
        GPIO number to use for I2S Data Driver.

config AT_ETHERNET_SUPPORT
    bool "AT ethernet support."
    default "n"
    depends on AT_ENABLE && IDF_TARGET_ESP32
    help
        Please pay attention to the usage. You can refer to the ESP32_AT_Ethernet.md and get more details.

choice PHY_MODEL
    prompt "Ethernet PHY"
    default PHY_IP101
    depends on AT_ETHERNET_SUPPORT
    help
        Select the PHY driver to use for ESP32 AT.

config PHY_IP101
    bool "IP101 PHY"
    help
        Select this to use the IP101 PHY

config PHY_RTL8201
    bool "RTL8201 PHY"
    help
        Select this to use the RTL8201 PHY

config PHY_DP83848
    bool "DP83848 PHY"
    help
        Select this to use the DP83848 PHY

config PHY_LAN8720
    bool "Microchip LAN8720 PHY"
    help
        Select this to use the Microchip LAN8720 PHY

endchoice

config AT_FS_COMMAND_SUPPORT
    bool "AT FS command support."
    default "n"
    depends on AT_ENABLE && !(IDF_TARGET_ESP32C2 && ESPTOOLPY_FLASHSIZE_2MB)

config AT_DRIVER_COMMAND_SUPPORT
    bool "AT driver command support."
    default "n"
    depends on AT_ENABLE

config AT_SIGNALING_COMMAND_SUPPORT
    bool "AT signaling test command support."
    default "y"
    depends on AT_ENABLE

config AT_EAP_COMMAND_SUPPORT
    bool "AT WPA2 Enterprise command support."
    default "n"
    depends on AT_WIFI_COMMAND_SUPPORT

config AT_WEB_SERVER_SUPPORT
    bool "AT WEB Server command support."
    default "n"
    depends on AT_ENABLE
    help
      Please enable this configure if you want use web server.

config AT_WEB_USE_FATFS
    bool "Use fatfs to store html"
    default "n"
    depends on AT_WEB_SERVER_SUPPORT && AT_FS_COMMAND_SUPPORT
    help
        If enable this configure, html will be stored in fatfs(Please enable AT FS Command).
        Otherwise, html file will be compiled as embedded code.
config AT_WEB_CAPTIVE_PORTAL_ENABLE
    bool "AT WEB captive portal support"
    default "n"
    depends on AT_WEB_SERVER_SUPPORT
    help
        If your mobile phone or PC supports captive portal,
        it will automatically open a browser for setting Wi-Fi station information when connects to ESP softAP.
        For more details, please refer to https://en.wikipedia.org/wiki/Captive_portal.
        Please enlarge LWIP_MAX_SOCKETS to be more than 14 to ensure access to the web smoothly.

config AT_WEB_ROOT_DIR
    string "AT WEB root dir."
    default "/"
    depends on AT_WEB_CAPTIVE_PORTAL_ENABLE
    help
        AT WEB root dir used for generateing default redirect url.
        The complete url is just like "http://192.168.4.1/".

config AT_OTA_SUPPORT
    bool "AT OTA command support."
    default "y"
    depends on AT_ENABLE

config AT_OTA_SERVER_IP
    string "Server IP for AT OTA."
    default "iot.espressif.cn"
    depends on AT_OTA_SUPPORT

config AT_OTA_SERVER_PORT
    int "Server port for AT OTA."
    default 80
    depends on AT_OTA_SUPPORT

config AT_OTA_TOKEN_KEY
    string "The token for AT OTA."
    default "dd93253c287f725de50d4071a05dd28b72056ca7"
    depends on AT_OTA_SUPPORT

config AT_OTA_SSL_SUPPORT
    bool "OTA based upon ssl"
    default "y"
    depends on AT_OTA_SUPPORT

config AT_OTA_SSL_SERVER_IP
    string "SSL server IP for AT OTA."
    default "iot.espressif.cn"
    depends on AT_OTA_SSL_SUPPORT

config AT_OTA_SSL_SERVER_PORT
    int "SSL server port for AT ssl OTA."
    default 443
    depends on AT_OTA_SSL_SUPPORT

config AT_OTA_SSL_TOKEN_KEY
    string "The SSL token for AT OTA."
    default "dd93253c287f725de50d4071a05dd28b72056ca7"
    depends on AT_OTA_SSL_SUPPORT

config ESP_AT_FW_VERSION
    string "AT firmware version."
    depends on AT_ENABLE
    help
      The maximum length of the string is 128 characters.
      If more than 128 characters, it will be invalid.

config AT_RAINMAKER_COMMAND_SUPPORT
    bool "AT RAINMAKER command support."
    default n
    depends on AT_ENABLE
    depends on IDF_TARGET_ESP32C3

menuconfig AT_DEBUG
    bool "Enable ESP-AT Debug"
    default n
    help
        Enabling this option allows different kinds of ESP-AT debug output, and these debug outputs will be sent to the AT log port.
        All ESP-AT debug features increase the size of the final binary.

    config AT_TX_DATA_DEBUG
        bool "Logging the data sent from AT to MCU (AT ----> MCU)"
        depends on AT_DEBUG && (LOG_DEFAULT_LEVEL_INFO || LOG_DEFAULT_LEVEL_DEBUG || LOG_DEFAULT_LEVEL_VERBOSE)
        default y

    config AT_TX_DATA_MAX_LEN
        int "The maximum length of the data sent from AT to MCU to be logged"
        depends on AT_TX_DATA_DEBUG
        default 8192
        help
            Logging the data with the length of AT_TX_DATA_MAX_LEN.
            You can speed up the data transfer by setting a smaller value.

    config AT_RX_DATA_DEBUG
        bool "Logging the data received by AT from MCU (AT <---- MCU)"
        depends on AT_DEBUG && (LOG_DEFAULT_LEVEL_INFO || LOG_DEFAULT_LEVEL_DEBUG || LOG_DEFAULT_LEVEL_VERBOSE)
        default y

    config AT_RX_DATA_MAX_LEN
        int "The maximum length of the data received by AT from MCU to be logged"
        depends on AT_RX_DATA_DEBUG
        default 8192
        help
            Logging the data with the length of AT_RX_DATA_MAX_LEN.
            You can speed up the data transfer by setting a smaller value.

    config AT_WIFI_DUMP_STATIS_DEBUG
        bool "Periodically dump Wi-Fi statistics"
        depends on AT_DEBUG && (LOG_DEFAULT_LEVEL_INFO || LOG_DEFAULT_LEVEL_DEBUG || LOG_DEFAULT_LEVEL_VERBOSE)
        default n

    config AT_WIFI_DUMP_STATIS_INTV_MS
        int "The interval of dumping Wi-Fi statistics (ms)"
        depends on AT_WIFI_DUMP_STATIS_DEBUG
        default 3000

    config AT_NET_DEBUG
        bool "Enable Network Debug"
        depends on AT_DEBUG && (LOG_DEFAULT_LEVEL_INFO || LOG_DEFAULT_LEVEL_DEBUG || LOG_DEFAULT_LEVEL_VERBOSE)
        default n
        help
            Enabling this option allows different kinds of network debug output, and these debug outputs will be sent to the AT log port.
            Attention: this network debug feature does not support IP fragment and IPv6 till now.

    config AT_NET_TCP_DEBUG
        bool "Enable the TCP packet debug messages"
        depends on AT_NET_DEBUG
        default y
        help
            Enabling this option to monitor the outgoing (TX) and incoming (RX) packets of TCP or protocol based on TCP (SSL/HTTP/MQTT/WebSocket/etc).
            It will print TCP packets information, which includes ip total len, tcp data len, tcp seq, tcp ack, src port, dest port, and tcp flags. TCP flags is the accumulation of CWR:128, ECN:64, Urgent:32, Ack:16, Push:8, Reset:4, SYN:2, FIN:1.

    config AT_NET_TCP_DEBUG_PORT_LIST
        string "Specify the list of TCP port numbers to monitor"
        depends on AT_NET_TCP_DEBUG
        default "0"
        help
            0 means all ports, and the port numbers should be separated by commas if monitor multiple ports.

    config AT_NET_UDP_DEBUG
        bool "Enable the UDP packet debug messages"
        depends on AT_NET_DEBUG
        default y
        help
            Enabling this option to monitor the outgoing (TX) and incoming (RX) packets of UDP or protocol based on UDP (DHCP/DNS/SNTP/mDNS/etc).
            It will print UDP packets information, which includes ip total len, src port, dest port, and udp data len.

    config AT_NET_UDP_DEBUG_TX_PORT_LIST
        string "Specify the list of outgoing UDP (UDP TX) port numbers to monitor"
        depends on AT_NET_UDP_DEBUG
        default "0"
        help
            0 means all ports, and the port numbers should be separated by commas if monitor multiple ports.

    config AT_NET_UDP_DEBUG_RX_PORT_LIST
        string "Specify the list of incoming UDP (UDP RX) port numbers to monitor"
        depends on AT_NET_UDP_DEBUG
        default "53, 67, 68, 123"
        help
            The port number should be separated by commas if monitor multiple ports.
            You should not set the port number to 0 to prevent UDP RX flooding.

    config AT_NET_ICMP_DEBUG
        bool "Enable the ICMP packet debug messages"
        depends on AT_NET_DEBUG
        default y
        help
            Enabling this option to monitor the outgoing (TX) and incoming (RX) packets of ICMP.
            It will print ICMP packets information, which includes ip total len, icmp type, id, seq, and icmp data len.

endmenu
```
