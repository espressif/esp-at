## main/interface/hspi/Kconfig
```kconfig
config AT_BASE_ON_HSPI
    bool "AT through HSPI"
    depends on !IDF_TARGET_ESP8266
    help
        If enable this option, the MCU can send AT command through SPI bus. 
        But besides the standard SPI pins, the more one pin is required to handshake MCU. 
        In order to respond in time, MCU should use the interrupt pin as the handshake pin.

choice SPI_TRANSMIT
    prompt "AT SPI Data Transmission Mode"
    depends on AT_BASE_ON_HSPI && !IDF_TARGET_ESP32
    default SPI_STANDARD_MODE

config SPI_STANDARD_MODE
    bool "Standard SPI"
    help
        Enable the one-line data transmission. The MCU can send data through MOSI line and receive data through MISO line.

config SPI_DUAL_MODE
    bool "Dual SPI"
    help
        Enable the two-line data transmission. The MCU can transmit data through MOSI and MISO line. 
        
config SPI_QUAD_MODE
    bool "Quad SPI"
    help
        Enable the four-line data transmission. In this mode, two more I/O lines for sending 4 data bits per clock cycle are needed.
endchoice


menu "AT SPI GPIO settings"
    depends on AT_BASE_ON_HSPI
    config SPI_SCLK_PIN
        int "SPI sclk pin"
        default 15 if (IDF_TARGET_ESP32S2 || IDF_TARGET_ESP32)
        default 6 if IDF_TARGET_ESP32C3

    config SPI_MOSI_PIN
        int "SPI mosi pin"
        default 13 if (IDF_TARGET_ESP32S2 || IDF_TARGET_ESP32)
        default 7 if IDF_TARGET_ESP32C3

    config SPI_MISO_PIN
        int "SPI miso pin"
        default 12 if (IDF_TARGET_ESP32S2 || IDF_TARGET_ESP32)
        default 2 if IDF_TARGET_ESP32C3

    config SPI_CS_PIN
        int "SPI cs pin"
        default 14 if (IDF_TARGET_ESP32S2 || IDF_TARGET_ESP32)
        default 10 if IDF_TARGET_ESP32C3

    config SPI_HANDSHAKE_PIN
        int "SPI handshake pin for slave send"
        default 5 if IDF_TARGET_ESP32S2
        default 3 if IDF_TARGET_ESP32C3
        default 4 if IDF_TARGET_ESP32

    config SPI_WP_PIN
        int "SPI WP pin(quad spi)"
        default 16 if IDF_TARGET_ESP32S2
        default 8 if IDF_TARGET_ESP32C3
        depends on SPI_QUAD_MODE
        
    config SPI_HD_PIN
        int "SPI HD pin(quad spi)"
        default 17 if IDF_TARGET_ESP32S2
        default 9 if IDF_TARGET_ESP32C3
        depends on SPI_QUAD_MODE
endmenu

menu "AT SPI driver settings"
    depends on AT_BASE_ON_HSPI
    config SPI_NUM
        int "SPI number"
        default 1
        range 1 2

    config SPI_MODE
        int "SPI mode"
        default 0
        range 0 3

    config TX_STREAM_BUFFER_SIZE
        int "TX stream buffer size"
        default 4096
        range 1024 8192

    config RX_STREAM_BUFFER_SIZE
        int "RX stream buffer size"
        default 4096
        range 1024 8192
endmenu
```

## main/interface/sdio/Kconfig
```kconfig
config AT_BASE_ON_SDIO
    bool "AT through SDIO"
	depends on IDF_TARGET_ESP32 || IDF_TARGET_ESP32C6
    help
        This demo is AT through SDIO. The MCU can send AT command through SDIO bus.

if AT_BASE_ON_SDIO
menu "AT SDIO settings"
config AT_SDIO_BLOCK_SIZE
 	int "SDIO block size"
	default 512
	depends on AT_BASE_ON_SDIO

config AT_SDIO_QUEUE_SIZE
 	int "SDIO queue size"
	default 20
	depends on AT_BASE_ON_SDIO

config AT_SDIO_BUFFER_NUM
 	int "SDIO buffer number"
	default 10
	depends on AT_BASE_ON_SDIO

endmenu
endif
```

## main/interface/socket/Kconfig
```kconfig
config AT_BASE_ON_SOCKET
    bool "AT through socket"

if AT_BASE_ON_SOCKET
menu "AT socket settings"
config AT_SOCKET_PORT
    int "The socket port bond by TCP server, and you can send AT commands via the socket after the tcp client connected this port"
    default 3333
endmenu
endif
```

## main/interface/spi/Kconfig
```kconfig
config AT_BASE_ON_SPI
    bool "AT through SPI"
    depends on (IDF_TARGET_ESP32C2 || IDF_TARGET_ESP32C3 || IDF_TARGET_ESP32C6)
    help
        If enable this option, the MCU can send AT command through SPI bus.
        But besides the standard SPI pins, the more one pin is required to handshake MCU.
        In order to respond in time, MCU should use the interrupt pin as the handshake pin.

choice SPI_TRANSMIT
    prompt "AT SPI Data Transmission Mode"
    depends on AT_BASE_ON_SPI
    default SPI_STANDARD_MODE

config SPI_STANDARD_MODE
    bool "Standard SPI"
    help
        Enable the one-line data transmission. The MCU can send data through MOSI line and receive data through MISO line.

config SPI_DUAL_MODE
    bool "Dual SPI"
    help
        Enable the two-line data transmission. The MCU can transmit data through MOSI and MISO line.

config SPI_QUAD_MODE
    bool "Quad SPI"
    help
        Enable the four-line data transmission. In this mode, two more I/O lines for sending 4 data bits per clock cycle are needed.
endchoice

menu "AT SPI GPIO settings"
    depends on AT_BASE_ON_SPI
    config SPI_SCLK_PIN
        int "SPI sclk pin"
        default 6 if IDF_TARGET_ESP32C3
        default 6 if IDF_TARGET_ESP32C2
        default 19 if IDF_TARGET_ESP32C6

    config SPI_MOSI_PIN
        int "SPI mosi pin"
        default 7 if IDF_TARGET_ESP32C3
        default 7 if IDF_TARGET_ESP32C2
        default 18 if IDF_TARGET_ESP32C6

    config SPI_MISO_PIN
        int "SPI miso pin"
        default 2 if IDF_TARGET_ESP32C3
        default 2 if IDF_TARGET_ESP32C2
        default 20 if IDF_TARGET_ESP32C6

    config SPI_CS_PIN
        int "SPI cs pin"
        default 10 if IDF_TARGET_ESP32C3
        default 10 if IDF_TARGET_ESP32C2
        default 23 if IDF_TARGET_ESP32C6

    config SPI_HANDSHAKE_PIN
        int "SPI handshake pin for slave send"
        default 3 if IDF_TARGET_ESP32C3
        default 3 if IDF_TARGET_ESP32C2
        default 21 if IDF_TARGET_ESP32C6

    config SPI_WP_PIN
        int "SPI WP pin(quad spi)"
        default 8 if IDF_TARGET_ESP32C3
        default 8 if IDF_TARGET_ESP32C2
        default 22 if IDF_TARGET_ESP32C6
        depends on SPI_QUAD_MODE

    config SPI_HD_PIN
        int "SPI HD pin(quad spi)"
        default 9 if IDF_TARGET_ESP32C3
        default 9 if IDF_TARGET_ESP32C2
        default 2 if IDF_TARGET_ESP32C6
        depends on SPI_QUAD_MODE
endmenu

menu "AT SPI driver settings"
    depends on AT_BASE_ON_SPI
    config SPI_NUM
        int "SPI number"
        default 1
        range 1 2

    config SPI_MODE
        int "SPI mode"
        default 0
        range 0 3

    config TX_STREAM_BUFFER_SIZE
        int "TX stream buffer size"
        default 4096
        range 1024 8192

    config RX_STREAM_BUFFER_SIZE
        int "RX stream buffer size"
        default 4096
        range 1024 8192
endmenu
```

## main/interface/uart/Kconfig
```kconfig
config AT_BASE_ON_UART
    bool "AT through UART"

if AT_BASE_ON_UART

    config AT_UART_COMMAND_SUPPORT
        bool "Support UART AT commands"
        default "y"

    menu "AT uart settings"
        config AT_UART_DEFAULT_DATABITS
            int "the uart data bits for AT port, the range is [5, 8]"
            default 8
            range 5 8
            depends on AT_BASE_ON_UART

        config AT_UART_DEFAULT_STOPBITS
            int "the uart stop bit for AT port, the range is [1, 3]"
            help
                1: 1-bit stop bit; 2: 1.5-bit stop bit; 3: 2-bit stop bit
            default 1
            range 1 3

        config AT_UART_DEFAULT_PARITY_BITS
            int "the uart parity bit for AT port, the range is [0, 2]"
            help
                0: None; 1: Odd; 2: Even
            default 0
            range 0 2

        config AT_UART_DEFAULT_FLOW_CONTROL
            int "the uart flow control for AT port, the range is [0, 3]"
            help
                0: flow control is disabled; 1: enable RTS; 2: enable CTS; 3: enable RTS and CTS
            default 1
            range 0 3
    endmenu

endif
```

## managed_components/espressif__esp_websocket_client/Kconfig
```kconfig
menu "ESP WebSocket client"

    config ESP_WS_CLIENT_ENABLE_DYNAMIC_BUFFER
        bool "Enable websocket client dynamic buffer for send and receive data"
        default n
        help
            Enable this option will reallocated buffer when send or receive data and free them when end of use.
            This can save about 2 KB memory when no websocket data send and receive.

endmenu
```

## module_config/module_esp32c2-2mb/sdkconfig.defaults
```kconfig
# The Optimized Configuration
# Do NOT edit unless you know exactly what you are doing

CONFIG_IDF_TARGET_ESP32C2=y

# Serial flasher config
CONFIG_ESPTOOLPY_FLASHMODE_DIO=y
CONFIG_ESPTOOLPY_FLASHFREQ_60M=y
CONFIG_ESPTOOLPY_FLASHSIZE_2MB=y

# Bootloader config
CONFIG_BOOTLOADER_WDT_ENABLE=y
CONFIG_BOOTLOADER_APP_ROLLBACK_ENABLE=y
CONFIG_BOOTLOADER_APP_ANTI_ROLLBACK=n
CONFIG_BOOTLOADER_COMPRESSED_ENABLED=y
CONFIG_ENABLE_LEGACY_ESP_BOOTLOADER_PLUS_V2_SUPPORT=y

# Partition Table
CONFIG_PARTITION_TABLE_CUSTOM=y
CONFIG_PARTITION_TABLE_CUSTOM_FILENAME="module_config/module_esp32c2-2mb/partitions_at.csv"
CONFIG_PARTITION_TABLE_OFFSET=0x8000
CONFIG_PARTITION_TABLE_FILENAME="module_config/module_esp32c2-2mb/partitions_at.csv"
CONFIG_PARTITION_TABLE_MD5=n

# PHY
CONFIG_ESP_PHY_INIT_DATA_IN_PARTITION=n

# Power Save
CONFIG_PM_ENABLE=y
CONFIG_PM_USE_RTC_TIMER_REF=y
### Disable all GPIO at light sleep
CONFIG_PM_SLP_DISABLE_GPIO=y

# ESP Ringbuf
CONFIG_RINGBUF_PLACE_FUNCTIONS_INTO_FLASH=y
CONFIG_RINGBUF_PLACE_ISR_FUNCTIONS_INTO_FLASH=y

# Wi-Fi
CONFIG_ESP_WIFI_SLP_IRAM_OPT=y
CONFIG_ESP_WIFI_STA_DISCONNECTED_PM_ENABLE=y
CONFIG_ESP32_WIFI_IRAM_OPT=n
CONFIG_ESP32_WIFI_RX_IRAM_OPT=n
CONFIG_ESP_WIFI_ESPNOW_MAX_ENCRYPT_NUM=0
CONFIG_ESP32_WIFI_SW_COEXIST_ENABLE=n
CONFIG_ESP32_WIFI_STATIC_RX_BUFFER_NUM=3

# Ethernet
CONFIG_ETH_USE_SPI_ETHERNET=n

# Log output
CONFIG_LOG_DEFAULT_LEVEL_ERROR=y
CONFIG_LOG_COLORS=n

# Compiler
CONFIG_COMPILER_OPTIMIZATION_DEFAULT=y

# Bluetooth
CONFIG_BT_ENABLED=n
CONFIG_BTDM_CTRL_MODE_ONLY=y
CONFIG_BTDM_SCAN_DUPL_CACHE_SIZE=200
CONFIG_BT_NIMBLE_ENABLED=y
CONFIG_BT_NIMBLE_BLUFI_ENABLE=y

# FreeRTOS
CONFIG_FREERTOS_UNICORE=y
CONFIG_FREERTOS_HZ=1000
CONFIG_FREERTOS_USE_TICKLESS_IDLE=y
CONFIG_FREERTOS_CHECK_MUTEX_GIVEN_BY_OWNER=n
CONFIG_FREERTOS_PLACE_FUNCTIONS_INTO_FLASH=y
CONFIG_FREERTOS_PLACE_SNAPSHOT_FUNS_INTO_FLASH=y

# LWIP
CONFIG_LWIP_SO_REUSE=y
CONFIG_LWIP_SO_RCVBUF=y
CONFIG_LWIP_DHCP_MAX_NTP_SERVERS=3
CONFIG_LWIP_SNTP_MAX_SERVERS=3
CONFIG_LWIP_IP_FRAG=y
CONFIG_LWIP_IP_REASSEMBLY=y
CONFIG_LWIP_TCP_MAXRTX=6
CONFIG_LWIP_TCP_SYNMAXRTX=3
CONFIG_LWIP_SO_LINGER=y
CONFIG_LWIP_IPV6=y
CONFIG_LWIP_IPV6_AUTOCONFIG=y
CONFIG_LWIP_TCP_MSS=1440
CONFIG_LWIP_TCP_SND_BUF_DEFAULT=5760
CONFIG_LWIP_TCP_WND_DEFAULT=5760

# mbedTLS
CONFIG_MBEDTLS_HAVE_TIME_DATE=y
CONFIG_MBEDTLS_HARDWARE_MPI=y
CONFIG_MBEDTLS_DHM_C=y
CONFIG_MBEDTLS_DYNAMIC_BUFFER=y
CONFIG_MBEDTLS_DYNAMIC_FREE_CONFIG_DATA=y
CONFIG_MBEDTLS_DYNAMIC_FREE_CA_CERT=y
CONFIG_MBEDTLS_SSL_KEEP_PEER_CERTIFICATE=n

# ESP-TLS
CONFIG_ESP_TLS_SERVER=y
CONFIG_ESP_TLS_PSK_VERIFICATION=y
CONFIG_ESP_TLS_INSECURE=y
CONFIG_ESP_TLS_SKIP_SERVER_CERT_VERIFY=y

# AT Customized Partitions
CONFIG_AT_CUSTOMIZED_PARTITION_TABLE_FILE="module_config/module_esp32c2-2mb/at_customize.csv"
CONFIG_AT_CUSTOMIZED_PARTITION_TABLE_OFFSET=0x1a000

# AT
CONFIG_AT_ENABLE=y
CONFIG_AT_BASE_ON_UART=y
CONFIG_AT_MQTT_COMMAND_SUPPORT=y
CONFIG_AT_HTTP_COMMAND_SUPPORT=n
CONFIG_AT_BLUFI_COMMAND_SUPPORT=n
CONFIG_AT_PROCESS_TASK_STACK_SIZE=4096
CONFIG_AT_OTA_SERVER_IP="iot.espressif.cn"
CONFIG_AT_OTA_SERVER_PORT=80
CONFIG_AT_OTA_TOKEN_KEY="dd93253c287f725de50d4071a05dd28b72056ca7"
CONFIG_AT_OTA_SSL_TOKEN_KEY="dd93253c287f725de50d4071a05dd28b72056ca7"
CONFIG_AT_SOCKET_MAX_CONN_NUM=5
CONFIG_ESP_AT_FW_VERSION="v3.4.0.0-dev"

# Wear Levelling
CONFIG_WL_SECTOR_SIZE_512=y

# VFS
CONFIG_FATFS_LFN_HEAP=y
CONFIG_VFS_SUPPORT_TERMIOS=n

# Newlib
CONFIG_NEWLIB_NANO_FORMAT=y

# Common ESP-related
CONFIG_ESP_TASK_WDT_TIMEOUT_S=60
CONFIG_ESP_TASK_WDT_PANIC=y
CONFIG_ESP_ERR_TO_NAME_LOOKUP=n

# Hardware Settings
CONFIG_XTAL_FREQ_26=y
CONFIG_RTC_CLK_CAL_CYCLES=1024

# Cache config
CONFIG_ESP_DEBUG_STUBS_ENABLE=n

# SPI Flash driver
CONFIG_SPI_FLASH_USE_LEGACY_IMPL=y
CONFIG_SPI_FLASH_ENABLE_ENCRYPTED_READ_WRITE=n
CONFIG_SPI_FLASH_ROM_IMPL=y

# HTTP Server
CONFIG_HTTPD_MAX_REQ_HDR_LEN=1024
CONFIG_HTTPD_MAX_URI_LEN=1024

# ESP System Settings
CONFIG_ESP_CONSOLE_UART_CUSTOM=y
CONFIG_ESP_CONSOLE_UART_NUM=0
CONFIG_ESP_CONSOLE_UART_TX_GPIO=8
CONFIG_ESP_CONSOLE_UART_RX_GPIO=9
CONFIG_ESP_CONSOLE_UART_BAUDRATE=115200

# ESP HTTPS OTA
CONFIG_ESP_HTTPS_OTA_ALLOW_HTTP=y
```
